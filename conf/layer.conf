## conf/layer.conf
```bitbake
BBPATH .= ":${LAYERDIR}"

BBFILES += "${LAYERDIR}/recipes-*/*/*.bb \
            ${LAYERDIR}/recipes-*/*/*.bbappend"

BBFILE_COLLECTIONS += "resin-extra"
BBFILE_PATTERN_resin-extra := "^${LAYERDIR}/"
BBFILE_PRIORITY_resin-extra = "1337"
```
